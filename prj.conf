## prj.conf
```kconfig
CONFIG_OPENTHREAD_FTD=y
CONFIG_NET_L2_OPENTHREAD=y
CONFIG_NETWORKING=y


CONFIG_OPENTHREAD_MANUAL_START=n
CONFIG_OPENTHREAD_NETWORK_NAME="WSN"
CONFIG_OPENTHREAD_PANID=10000
CONFIG_OPENTHREAD_XPANID="fb:02:00:00:ab:cd:00:00"
CONFIG_OPENTHREAD_NETWORKKEY="00:11:22:33:44:55:66:77:88:99:aa:bb:cc:dd:ee:ff"


CONFIG_SHELL=y
CONFIG_OPENTHREAD_SHELL=y
CONFIG_SHELL_ARGC_MAX=26
CONFIG_SHELL_CMD_BUFF_SIZE=416


CONFIG_MBEDTLS_SHA1_C=n
CONFIG_FPU=y
CONFIG_GPIO=y
```

## nrf52840dk_nrf52840.overlay
```dts
// To get started, press Ctrl+Space to bring up the completion menu and view the available nodes.

// You can also use the buttons in the sidebar to perform actions on nodes.
// Actions currently available include:

// * Enabling / disabling the node
// * Adding the bus to a bus
// * Removing the node
// * Connecting ADC channels

// For more help, browse the DeviceTree documentation at https://docs.zephyrproject.org/latest/guides/dts/index.html
// You can also visit the nRF DeviceTree extension documentation at https://docs.nordicsemi.com/bundle/nrf-connect-vscode/page/guides/ncs_configure_app.html#devicetree-support-in-the-extension
/ {
    chosen {
        zephyr,entropy = &rng;
    };
};
```

## src/main.c
```c
#include <zephyr/zephyr.h>
#include <zephyr/drivers/gpio.h>


#include <openthread/thread.h>
#include <openthread/udp.h> 


/* 1000 msec = 1 sec */
#define SLEEP_TIME_MS   1000

/* The devicetree node identifier for the "led0" alias. */
#define BUTTON0_NODE DT_NODELABEL(button0)


static void udp_send(void);



void button0_pressed_callback(const struct device *gpiob, struct gpio_callback *cb, gpio_port_pins_t pins){
	udp_send();
}


void main(void)
{	
	static const struct gpio_dt_spec button0 = GPIO_DT_SPEC_GET(BUTTON0_NODE, gpios);
	if (!(device_is_ready(button0.port))) {printk("port isn't ready\n"); return;}

	gpio_pin_configure_dt(&button0, GPIO_INPUT);
	gpio_pin_interrupt_configure_dt(&button0,GPIO_INT_EDGE_TO_INACTIVE); // configured interrupt
	static struct gpio_callback button0_cb; // will hold information such as the pin number and the function to be called when an interrupt occurs (callback function).
	gpio_init_callback(&button0_cb, button0_pressed_callback, BIT(button0.pin));  /* Initialize the struct gpio_callback button_cb_data by passing this variable,
	along with the callback function and the bit mask for the GPIO pin button.pin to gpio_init_callback().*/
	gpio_add_callback(button0.port, &button0_cb); // add the callback func


	while (1) {
		
		k_msleep(SLEEP_TIME_MS);
	}
}


static void udp_send(void) 
{
	otError error = OT_ERROR_NONE;
	const char *buf = "Hello Thread xd"; 

	otInstance *myInstance; 
	myInstance = openthread_get_default_instance();
	otUdpSocket mySocket; 

	otMessageInfo messageInfo;
	memset(&messageInfo, 0, sizeof(messageInfo)); 
	otIp6AddressFromString("ff03::1", &messageInfo.mPeerAddr);
	messageInfo.mPeerPort = 2222; 

	do{
		error = otUdpOpen(myInstance, &mySocket, NULL, NULL);
		if (error != OT_ERROR_NONE) break;

		otMessage *test_Message = otUdpNewMessage(myInstance, NULL);
		error = otMessageAppend(test_Message, buf, (uint16_t)strlen(buf));
		if (error != OT_ERROR_NONE) break;

		error = otUdpSend(myInstance, &mySocket, test_Message, &messageInfo);
		if (error != OT_ERROR_NONE) break;

		error = otUdpClose(myInstance, &mySocket);
		
	}while(false); 

	if (error == OT_ERROR_NONE)
		printk("Sent.\n");
	else	
		printk("udpSend error: %d\n", error);
}
```
